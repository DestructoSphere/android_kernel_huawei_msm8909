/* Copyright (c) 2014, The Linux Foundation. All rights reserved.
 *
 * This program is free software; you can redistribute it and/or modify
 * it under the terms of the GNU General Public License version 2 and
 * only version 2 as published by the Free Software Foundation.
 *
 * This program is distributed in the hope that it will be useful,
 * but WITHOUT ANY WARRANTY; without even the implied warranty of
 * MERCHANTABILITY or FITNESS FOR A PARTICULAR PURPOSE.  See the
 * GNU General Public License for more details.
 */
 
/dts-v1/;

#include "msm8909-qrd.dtsi"
#include "huawei_base.dtsi"
#include "huawei_msm8909_y538_a1_va/huawei.dtsi"
#include "huawei_msm8909_y538_a1_va/huawei_y538_a1_lcd.dtsi"

/ {
	model = "Qualcomm MSM 8909 HUAWEI Y538_A1";
        compatible = "qcom,msm8909-qrd", "qcom,msm8909", "qcom,qrd";
	qcom,board-id= <8132 0x1000>;
	huawei,modem_id = <0xFDB80180 0x0>;
};
