 / {
        huawei_fac_info {
                  compatible = "huawei,hw_fac_info";
                  fac,product_name = "HUAWEI Scale";
                  fac,hardware_ver = "HL1SCALETM";
                  fac,software_ver = "MSM8909_SCALE_MAINBOARD_VA";
                  status = "ok";
        };
};
