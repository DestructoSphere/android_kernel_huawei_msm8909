/* Copyright (c) 2013, The Linux Foundation. All rights reserved.
 *
 * This program is free software; you can redistribute it and/or modify
 * it under the terms of the GNU General Public License version 2 and
 * only version 2 as published by the Free Software Foundation.
 *
 * This program is distributed in the hope that it will be useful,
 * but WITHOUT ANY WARRANTY; without even the implied warranty of
 * MERCHANTABILITY or FITNESS FOR A PARTICULAR PURPOSE.  See the
 * GNU General Public License for more details.
 */

/*---------------------------------------------------------------------------
 * This file is autogenerated file using gcdb parser. Please do not edit it.
 * Update input XML file to add a new entry or update variable in this file
 * VERSION = "1.0"
 *---------------------------------------------------------------------------*/
&mdss_mdp {
	dsi_cmi_otm1283a_5_720pxa_video: qcom,mdss_dsi_cmi_otm1283a_5_720pxa_video {
		qcom,mdss-dsi-panel-name = "CMI_OTM1283A_5_720P_VIDEO";
		qcom,cont-splash-enabled;
		qcom,mdss-dsi-panel-controller = <&mdss_dsi0>;
		qcom,mdss-dsi-panel-type = "dsi_video_mode";
		qcom,mdss-dsi-panel-destination = "display_1";
		qcom,mdss-dsi-panel-clockrate = <428000000>;
		qcom,mdss-dsi-panel-framerate = <60>;
		qcom,mdss-dsi-virtual-channel-id = <0>;
		qcom,mdss-dsi-stream = <0>;
		qcom,mdss-dsi-panel-width = <720>;
		qcom,mdss-dsi-panel-height = <1280>;
		qcom,mdss-dsi-h-front-porch = <84>;
		qcom,mdss-dsi-h-back-porch = <84>;
		qcom,mdss-dsi-h-pulse-width = <12>;
		qcom,mdss-dsi-h-sync-skew = <0>;
		qcom,mdss-dsi-v-back-porch = <20>;
		qcom,mdss-dsi-v-front-porch = <20>;
		qcom,mdss-dsi-v-pulse-width = <3>;
		qcom,mdss-dsi-h-left-border = <0>;
		qcom,mdss-dsi-h-right-border = <0>;
		qcom,mdss-dsi-v-top-border = <0>;
		qcom,mdss-dsi-v-bottom-border = <0>;
		qcom,mdss-dsi-bpp = <24>;
		qcom,mdss-dsi-underflow-color = <0x00>;
		qcom,mdss-dsi-border-color = <0>;
		qcom,mdss-dsi-color-order = "rgb_swap_rgb";
		qcom,mdss-dsi-on-command = [29 01 00 00 00 00 02 00 00
			29 01 00 00 00 00 04 FF 12 83 01
			29 01 00 00 00 00 02 00 80
			29 01 00 00 00 00 03 FF 12 83
			29 01 00 00 00 00 02 00 92
			29 01 00 00 00 00 03 FF 30 02
			29 01 00 00 00 00 02 00 B9
			29 01 00 00 00 00 02 B0 51
			29 01 00 00 00 00 02 00 C6
			29 01 00 00 00 00 02 B0 03
			29 01 00 00 00 00 02 00 80
			29 01 00 00 00 00 0A C0 00 64 00 10 10 00 64 10 10
			29 01 00 00 00 00 02 00 90
			29 01 00 00 00 00 07 C0 00 5C 00 01 00 04
			29 01 00 00 00 00 02 00 B3
			29 01 00 00 00 00 03 C0 00 50
			29 01 00 00 00 00 02 00 B4
			29 01 00 00 00 00 02 C0 55
			29 01 00 00 00 00 02 00 81
			29 01 00 00 00 00 02 C1 66
			29 01 00 00 00 00 02 00 80
			29 01 00 00 00 00 02 C4 01
			29 01 00 00 00 00 02 00 81
			29 01 00 00 00 00 02 C4 80
			29 01 00 00 00 00 02 00 82
			29 01 00 00 00 00 02 C4 02
			29 01 00 00 00 00 02 00 88
			29 01 00 00 00 00 02 C4 80
			29 01 00 00 00 00 02 00 8B
			29 01 00 00 00 00 02 C4 40
			29 01 00 00 00 00 02 00 90
			29 01 00 00 00 00 02 C4 49
			29 01 00 00 00 00 02 00 E0
			29 01 00 00 00 00 02 C0 C8
			29 01 00 00 00 00 02 00 A0
			29 01 00 00 00 00 0F C4 05 10 04 02 05 15 11 05 10 07 02 05 15 11
			29 01 00 00 00 00 02 00 B0
			29 01 00 00 00 00 03 C4 00 00
			29 01 00 00 00 00 02 00 90
			29 01 00 00 00 00 05 C5 50 A6 D0 66
			29 01 00 00 00 00 02 00 B0
			29 01 00 00 00 00 03 C5 04 38
			29 01 00 00 00 00 02 00 B4
			29 01 00 00 00 00 02 C5 C0
			29 01 00 00 00 00 02 00 B5
			29 01 00 00 00 00 07 C5 0B 95 FF 0B 95 FF
			29 01 00 00 00 00 02 00 BB
			29 01 00 00 00 00 02 C5 80
			29 01 00 00 00 00 02 00 90
			29 01 00 00 00 00 05 F5 02 11 02 11
			29 01 00 00 00 00 02 00 94
			29 01 00 00 00 00 02 F5 02
			29 01 00 00 00 00 02 00 B2
			29 01 00 00 00 00 09 F5 00 00 00 00  00 00 00 00
			29 01 00 00 00 00 02 00 BA
			29 01 00 00 00 00 02 F5 03
			29 01 00 00 00 00 02 00 C2
			29 01 00 00 00 00 02 F5 C0
			29 01 00 00 00 00 02 00 80
			29 01 00 00 00 00 0C CB 00 00 00 00 00 00 00 00 00 00 00
			29 01 00 00 00 00 02 00 90
			29 01 00 00 00 00 10 CB 00 00 00 00 00 00 00 00 00 00 00 00 00 00 00
			29 01 00 00 00 00 02 00 A0
			29 01 00 00 00 00 10 CB 00 00 00 00 00 00 00 00 00 00 00 00 00 00 00
			29 01 00 00 00 00 02 00 B0
			29 01 00 00 00 00 10 CB 00 00 00 00 00 00 00 00 00 00 00 00 00 00 00
			29 01 00 00 00 00 02 00 C0
			29 01 00 00 00 00 10 CB 05 04 04 04 04 04 04 04 04 00 04 00 00 00 00
			29 01 00 00 00 00 02 00 D0
			29 01 00 00 00 00 10 CB 00 00 00 00 04 00 00 04 04 04 04 04 04 04 04
			29 01 00 00 00 00 02 00 E0
			29 01 00 00 00 00 0F CB 04 00 04 00 00 00 00 00 00 00 00 04 00 00
			29 01 00 00 00 00 02 00 F0
			29 01 00 00 00 00 0C CB FF FF FF FF FF FF FF FF FF FF FF
			29 01 00 00 00 00 02 00 80
			29 01 00 00 00 00 10 CC 29 2A 0A 0C 0E 10 12 14 06 00 08 00 00 00 00
			29 01 00 00 00 00 02 00 90
			29 01 00 00 00 00 10 CC 00 00 00 00 02 00 00 29 2A 09 0B 0D 0F 11 13
			29 01 00 00 00 00 02 00 A0
			29 01 00 00 00 00 0F CC 05 00 07 00 00 00 00 00 00 00 00 01 00 00
			29 01 00 00 00 00 02 00 B0
			29 01 00 00 00 00 10 CC 29 2A 13 11 0F 0D 0B 09 01 00 07 00 00 00 00
			29 01 00 00 00 00 02 00 C0
			29 01 00 00 00 00 10 CC  00 00 00 00 05 00 00 29 2A 14 12 10 0E 0C 0A
			29 01 00 00 00 00 02 00 D0
			29 01 00 00 00 00 0F CC 02 00 08 00 00 00 00 00 00 00 00 06 00 00
			29 01 00 00 00 00 02 00 80
			29 01 00 00 00 00 0D CE 89 05 10 88 05 10 00 00 00 00 00 00
			29 01 00 00 00 00 02 00 90
			29 01 00 00 00 00 0F CE 54 FD 10 54 FE 10 55 01 10 55 02 10 00 00
			29 01 00 00 00 00 02 00 A0
			29 01 00 00 00 00 0F CE 58 07 04 FD 00 10 00 58 06 04 FE 00 10 00
			29 01 00 00 00 00 02 00 B0
			29 01 00 00 00 00 0F CE 58 05 04 FF 00 10 00 58 04 05 00 00 10 00
			29 01 00 00 00 00 02 00 C0
			29 01 00 00 00 00 0F CE 58 03 05 01 00 10 00 58 02 05 02 00 10 00
			29 01 00 00 00 00 02 00 D0
			29 01 00 00 00 00 0F CE 58 01 05 03 00 10 00 58 00 05 04 00 10 00
			29 01 00 00 00 00 02 00 80
			29 01 00 00 00 00 0F CF 50 00 05 05 00 10 00 50 01 05 06 00 10 00
			29 01 00 00 00 00 02 00 90
			29 01 00 00 00 00 0F CF 50 02 05 07 00 10 00 50 03 05 08 00 10 00
			29 01 00 00 00 00 02 00 A0
			29 01 00 00 00 00 0F CF 00 00 00 00 00 00 00 00 00 00 00 00 00 00
			29 01 00 00 00 00 02 00 B0
			29 01 00 00 00 00 0F CF 00 00 00 00 00 00 00 00 00 00 00 00 00 00
			29 01 00 00 00 00 02 00 C0
			29 01 00 00 00 00 0C CF 39 39 20 20 00 00 01 01 20 00 00
			29 01 00 00 00 00 02 00 00
			29 01 00 00 00 00 03 D8 BE BE
			29 01 00 00 00 00 02 00 00
			29 01 00 00 00 00 11 E1 02 07 14 0D 07 11 0C 0A 03 07 0D 09 10 14 0E 08
			29 01 00 00 00 00 02 00 00
			29 01 00 00 00 00 11 E2 02 07 14 0D 07 11 0C 0B 03 07 0E 09 10 14 0E 08
			29 01 00 00 00 00 02 00 00
			29 01 00 00 00 00 22 EC 40 43 43 34 34 44 44 43 43 34 34 44 43 34 44 43 34 34 44 43 34 44 43 43 44 43 43 43 44 43 43 43 04
			29 01 00 00 00 00 02 00 00
			29 01 00 00 00 00 22 ED 40 34 44 34 34 44 44 43 43 44 34 44 43 44 44 43 34 44 34 44 34 44 43 44 44 43 44 43 44 43 44 43 04
			29 01 00 00 00 00 02 00 00
			29 01 00 00 00 00 22 EE 40 44 44 44 34 44 44 43 43 44 34 45 43 44 44 43 44 44 44 44 34 54 53 44 44 43 54 43 54 43 44 43 05
			29 01 00 00 00 00 02 00 B1
			29 01 00 00 00 00 02 C6 02
			29 01 00 00 00 00 02 00 B4
			29 01 00 00 00 00 02 C6 10
			29 01 00 00 00 00 02 00 90
			29 01 00 00 00 00 02 D6 60
			29 01 00 00 00 00 02 00 A0
			29 01 00 00 00 00 0D D6 01 00 01 00 01 7F 01 FD 01 FD 01 FD
			29 01 00 00 00 00 02 00 B0
			29 01 00 00 00 00 0D D6 01 FD 15 FD 15 FD 15 FD 01 FD 01 FD
			29 01 00 00 00 00 02 00 C0
			29 01 00 00 00 00 0D D6 54 11 00 A9 11 A9 A9 11 A9 A9 11 A9
			29 01 00 00 00 00 02 00 D0
			29 01 00 00 00 00 07 D6 A9 11 A9 A9 11 A9
			29 01 00 00 00 00 02 00 E0
			29 01 00 00 00 00 0D D6 54 11 54 54 11 54 54 11 54 54 11 54
			29 01 00 00 00 00 02 00 F0
			29 01 00 00 00 00 07 D6 54 11 54 54 11 54
			29 01 00 00 00 00 02 00 80
			29 01 00 00 00 00 02 D6 00
			29 01 00 00 00 00 02 00 81
			29 01 00 00 00 00 02 D6 00
			29 01 00 00 00 00 02 00 90
			29 01 00 00 00 00 02 D6 00
			29 01 00 00 00 00 02 00 83
			29 01 00 00 00 00 02 B3 01
			29 01 00 00 00 00 02 00 90
			29 01 00 00 00 00 02 B0 00
			29 01 00 00 00 00 02 00 00
			29 01 00 00 00 00 04 FF FF FF FF
			15 01 00 00 00 00 02 51 00
			15 01 00 00 00 00 02 53 24
			15 01 00 00 00 00 02 55 81
			15 01 00 00 00 00 02 5E 28
			05 01 00 00 78 00 02 11 00
			05 01 00 00 16 00 02 29 00];
		qcom,mdss-dsi-off-command = [05 01 00 00 32 00 02 28 00
				05 01 00 00 78 00 02 10 00];
		qcom,mdss-dsi-on-command-state = "dsi_lp_mode";
		qcom,mdss-dsi-off-command-state = "dsi_hs_mode";
		qcom,mdss-dsi-h-sync-pulse = <1>;
		qcom,mdss-dsi-traffic-mode = "burst_mode";
		qcom,mdss-dsi-lane-map = "lane_map_0123";
		qcom,mdss-dsi-bllp-eof-power-mode;
		qcom,mdss-dsi-bllp-power-mode;
		qcom,mdss-dsi-lane-0-state;
		qcom,mdss-dsi-lane-1-state;
		qcom,mdss-dsi-lane-2-state;
		qcom,mdss-dsi-lane-3-state;
		qcom,mdss-dsi-panel-timings = [7a 1a 12 00 3e 42 16 1e 14 03 04 00];
		qcom,mdss-dsi-t-clk-post = <0x04>;
		qcom,mdss-dsi-t-clk-pre = <0x1a>;
		qcom,mdss-dsi-bl-min-level = <6>;
		qcom,mdss-dsi-bl-max-level = <250>;
		qcom,mdss-dsi-dma-trigger = "trigger_sw";
		qcom,mdss-dsi-mdp-trigger = "none";
		qcom,mdss-dsi-bl-pmic-control-type = "bl_ctrl_dcs";
		qcom,panel-inverse-off-cmds = [05 01 00 00 00 00 02 20 00];
		qcom,panel-inverse-on-cmds = [05 01 00 00 00 00 02 21 00];
		qcom,inverse-on-cmds-dsi-state = "dsi_lp_mode";
		qcom,inverse-off-cmds-dsi-state = "dsi_lp_mode";
		qcom,panel-cabc-ui-cmds = [15 01 00 00 00 00 02 55 81
					15 01 00 00 00 00 02 53 24];
		qcom,panel-cabc-video-cmds = [15 01 00 00 00 00 02 55 83
					15 01 00 00 00 00 02 53 2C];
		qcom,cabc-ui-cmds-dsi-state = "dsi_lp_mode";
		qcom,cabc-video-cmds-dsi-state = "dsi_lp_mode";
		qcom,panel-dot-inversion-mode-cmds = [29 01 00 00 00 00 02 00 00
			      29 01 00 00 00 00 04 FF 12 83 01
			      29 01 00 00 00 00 02 00 80
			      29 01 00 00 00 00 03 FF 12 83
			      29 01 00 00 00 00 02 00 B4
			      29 01 00 00 00 00 02 C0 00
			      29 01 00 00 00 00 02 00 00
			      29 01 00 00 00 00 04 FF FF FF FF];
		qcom,panel-column-inversion-mode-cmds = [29 01 00 00 00 00 02 00 00
			      29 01 00 00 00 00 04 FF 12 83 01
			      29 01 00 00 00 00 02 00 80
			      29 01 00 00 00 00 03 FF 12 83
			      29 01 00 00 00 00 02 00 B4
			      29 01 00 00 00 00 02 C0 50
			      29 01 00 00 00 00 02 00 00
			      29 01 00 00 00 00 04 FF FF FF FF];
		qcom,dot-inversion-cmds-dsi-state = "dsi_lp_mode";
		qcom,column-inversion-cmds-dsi-state = "dsi_lp_mode";
		qcom,panel-esd-check-enabled;
		qcom,panel-esd-read-commands = [06 01 00 01 05 00 02 0A 9C
			 06 01 00 01 05 00 02 0D 00];
		qcom,esd-read-cmds-state = "dsi_hs_mode";
		qcom,mdss-dsi-lp11-init;
		qcom,mdss-pan-physical-width-dimension = <62>;
		qcom,mdss-pan-physical-height-dimension = <110>;
		qcom,mdss-dsi-reset-sequence = <1 1>, <0 20>, <1 20>;

	};
};
