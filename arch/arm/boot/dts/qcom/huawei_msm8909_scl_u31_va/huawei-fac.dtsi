 / {
        huawei_fac_info {
                  compatible = "huawei,hw_fac_info";
                  fac,product_name = "HUAWEI SCL-U31";
                  fac,hardware_ver = "HL3SCALEM";
                  fac,software_ver = "MSM8909_SCL_U31_VA";
                  status = "ok";
        };
};
