/*---------------------------------------------------------------------------
 * This file is autogenerated file using huawei LCD parser. Please do not edit it.
 * Update input XML file to add a new entry or update variable in this file
 * Parser location: device/qcom/common/display/tools/huawei_lcd_panel 
 *---------------------------------------------------------------------------*/


#include "hw-panel-boe-nt35512-4p5-fwvga-video.dtsi"
#include "hw-panel-tianma-ili9806c-4p5-fwvga-video.dtsi"
