&sdhc_2 {

           huawei,support-polling;
     };
&sdc2_cd_on {
/delete-property/ bias-pull-up;
/delete-property/ bias-disable;
bias-pull-down;
};

&sdc2_cd_off {
/delete-property/ bias-pull-up;
/delete-property/ bias-disable;
bias-pull-down;
};

