/* Copyright (c) 2013, The Linux Foundation. All rights reserved.
 *
 * This program is free software; you can redistribute it and/or modify
 * it under the terms of the GNU General Public License version 2 and
 * only version 2 as published by the Free Software Foundation.
 *
 * This program is distributed in the hope that it will be useful,
 * but WITHOUT ANY WARRANTY; without even the implied warranty of
 * MERCHANTABILITY or FITNESS FOR A PARTICULAR PURPOSE.  See the
 * GNU General Public License for more details.
 */

/*---------------------------------------------------------------------------
 * This file is autogenerated file using gcdb parser. Please do not edit it.
 * Update input XML file to add a new entry or update variable in this file
 * VERSION = "1.0"
 *---------------------------------------------------------------------------*/
&mdss_mdp {
	dsi_tianma_ili9806c_4p5_fwvga_video: qcom,mdss_dsi_tianma_ili9806c_4p5_fwvga_video {
		qcom,mdss-dsi-panel-name = "TIANMA_ILI9806c_4P5_FWVGA_VIDEO";
		qcom,cont-splash-enabled;
		qcom,mdss-dsi-panel-controller = <&mdss_dsi0>;
		qcom,mdss-dsi-panel-type = "dsi_video_mode";
		qcom,mdss-dsi-panel-destination = "display_1";
		qcom,mdss-dsi-panel-clockrate = <429320000>;
		qcom,mdss-dsi-panel-framerate = <60>;
		qcom,mdss-dsi-virtual-channel-id = <0>;
		qcom,mdss-dsi-stream = <0>;
		qcom,mdss-dsi-panel-width = <480>;
		qcom,mdss-dsi-panel-height = <854>;
		qcom,mdss-dsi-h-front-porch = <80>;
		qcom,mdss-dsi-h-back-porch = <80>;
		qcom,mdss-dsi-h-pulse-width = <24>;
		qcom,mdss-dsi-h-sync-skew = <0>;
		qcom,mdss-dsi-v-back-porch = <16>;
		qcom,mdss-dsi-v-front-porch = <24>;
		qcom,mdss-dsi-v-pulse-width = <4>;
		qcom,mdss-dsi-h-left-border = <0>;
		qcom,mdss-dsi-h-right-border = <0>;
		qcom,mdss-dsi-v-top-border = <0>;
		qcom,mdss-dsi-v-bottom-border = <0>;
		qcom,mdss-dsi-bpp = <24>;
		qcom,mdss-dsi-underflow-color = <0xff>;
		qcom,mdss-dsi-border-color = <0>;
		qcom,mdss-dsi-color-order = "rgb_swap_rgb";
		qcom,mdss-dsi-pixel-packing = "tight";
		qcom,mdss-dsi-on-command = [29 01 00 00 00 00 04 FF FF 98 16
			29 01 00 00 00 00 18 BC 03 09 61 FF 01 01 1B 0D 6C 63 FF FF 19 19 00 00 F2 F0 00 00 00 43 0B 
			29 01 00 00 00 00 09 BD 01 23 45 67 01 23 45 67 
			29 01 00 00 00 00 12 BE 13 11 00 22 22 CB BA AD DC 76 67 22 22 22 22 22 22
			29 01 00 00 00 00 03 ED 7F 0F
			29 01 00 00 00 00 02 F3 70
			29 01 00 00 00 00 02 B4 00
			29 01 00 00 00 00 04 C0 0F 0B 08
			29 01 00 00 00 00 05 C1 17 50 50 20
			29 01 00 00 00 00 02 CC 04
			29 01 00 00 00 00 04 F9 04 F9 80
			29 01 00 00 00 00 02 C8 02
			29 01 00 00 00 00 02 FC 07
			29 01 00 00 00 00 11 E0 00 25 25 0B 0E 06 08 07 06 09 17 14 15 06 0F 00
			29 01 00 00 00 00 11 E1 00 25 25 0B 0E 06 08 07 06 09 17 14 15 06 0F 00
			29 01 00 00 00 00 04 EC 24 4F 00
			29 01 00 00 00 00 09 D5 09 08 07 06 CB A5 01 04
			29 01 00 00 00 00 09 D6 FF A0 88 14 04 64 28 3A
			29 01 00 00 00 00 02 F7 89
			29 01 00 00 00 00 02 C7 A0
			15 01 00 00 00 00 02 36 03
			15 01 00 00 00 00 02 51 00
			15 01 00 00 00 00 02 53 24
			15 01 00 00 00 00 02 55 01
			15 01 00 00 00 00 02 5E 28
			05 01 00 00 78 00 02 11 00
			29 01 00 00 00 00 0A EE 0A 1B 5F 40 00 00 10 00 58
			05 01 00 00 14 00 02 29 00];
		qcom,mdss-dsi-off-command = [05 01 00 00 14 00 02 28 00
					05 01 00 00 78 00 02 10 00];
		qcom,mdss-dsi-on-command-state = "dsi_lp_mode";
		qcom,mdss-dsi-off-command-state = "dsi_hs_mode";
		qcom,mdss-dsi-h-sync-pulse = <1>;
		qcom,mdss-dsi-traffic-mode = "burst_mode";
		qcom,mdss-dsi-lane-map = "lane_map_3012";
		qcom,mdss-dsi-bllp-eof-power-mode;
		qcom,mdss-dsi-bllp-power-mode;
		qcom,mdss-dsi-hfpPowerMode;
		qcom,mdss-dsi-hbpPowerMode;
		qcom,mdss-dsi-hsaPowerMode;
		qcom,mdss-dsi-lane-0-state;
		qcom,mdss-dsi-lane-1-state;
		qcom,mdss-dsi-panel-timings = [7a 1a 12 00 3e 42 16 1e 14 03 04 00];
		qcom,mdss-dsi-t-clk-post = <0x04>;
		qcom,mdss-dsi-t-clk-pre = <0x19>;
		qcom,mdss-dsi-bl-min-level = <10>;
		qcom,mdss-dsi-bl-max-level = <250>;
		qcom,mdss-dsi-dma-trigger = "trigger_sw";
		qcom,mdss-dsi-mdp-trigger = "none";
		qcom,mdss-dsi-bl-pmic-control-type = "bl_ctrl_dcs";
		qcom,panel-inverse-off-cmds = [05 01 00 00 00 00 02 20 00];
		qcom,panel-inverse-on-cmds = [05 01 00 00 00 00 02 21 00];
		qcom,inverse-on-cmds-dsi-state = "dsi_lp_mode";
		qcom,inverse-off-cmds-dsi-state = "dsi_lp_mode";
		qcom,panel-cabc-ui-cmds = [15 01 00 00 00 00 02 55 01
					15 01 00 00 00 00 02 53 24];
		qcom,panel-cabc-video-cmds = [15 01 00 00 00 00 02 55 03
					15 01 00 00 00 00 02 53 2C];
		qcom,cabc-ui-cmds-dsi-state = "dsi_hs_mode";
		qcom,cabc-video-cmds-dsi-state = "dsi_hs_mode";
		qcom,panel-dot-inversion-mode-cmds = [29 01 00 00 00 00 02 B4 01];
		qcom,panel-column-inversion-mode-cmds = [29 01 00 00 00 00 02 B4 00];
		qcom,dot-inversion-cmds-dsi-state = "dsi_lp_mode";
		qcom,column-inversion-cmds-dsi-state = "dsi_lp_mode";
		qcom,mdss-dsi-lp11-init;
		qcom,mdss-pan-physical-width-dimension = <55>;
		qcom,mdss-pan-physical-height-dimension = <99>;
		qcom,mdss-dsi-reset-sequence = <1 1>, <0 20>, <1 120>;

	};
};
