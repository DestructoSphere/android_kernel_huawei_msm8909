 / {
        huawei_fac_info {
                  compatible = "huawei,hw_fac_info";
                  fac,product_name = "HUAWEI SCL-TL00";
                  fac,hardware_ver = "HL2SCALE1MAH";
                  fac,software_ver = "MSM8909_SCL_TL_VB";
                  status = "ok";
        };
};
