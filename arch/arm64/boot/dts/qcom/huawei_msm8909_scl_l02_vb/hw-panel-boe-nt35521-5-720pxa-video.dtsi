/* Copyright (c) 2013, The Linux Foundation. All rights reserved.
 *
 * This program is free software; you can redistribute it and/or modify
 * it under the terms of the GNU General Public License version 2 and
 * only version 2 as published by the Free Software Foundation.
 *
 * This program is distributed in the hope that it will be useful,
 * but WITHOUT ANY WARRANTY; without even the implied warranty of
 * MERCHANTABILITY or FITNESS FOR A PARTICULAR PURPOSE.  See the
 * GNU General Public License for more details.
 */

/*---------------------------------------------------------------------------
 * This file is autogenerated file using gcdb parser. Please do not edit it.
 * Update input XML file to add a new entry or update variable in this file
 * VERSION = "1.0"
 *---------------------------------------------------------------------------*/
&mdss_mdp {
	dsi_boe_nt35521_5_720pxa_video: qcom,mdss_dsi_boe_nt35521_5_720pxa_video {
		qcom,mdss-dsi-panel-name = "BOE_NT35521_5_720P_VIDEO";
		qcom,cont-splash-enabled;
		qcom,mdss-dsi-panel-controller = <&mdss_dsi0>;
		qcom,mdss-dsi-panel-type = "dsi_video_mode";
		qcom,mdss-dsi-panel-destination = "display_1";
		qcom,mdss-dsi-panel-clockrate = <428000000>;
		qcom,mdss-dsi-panel-framerate = <60>;
		qcom,mdss-dsi-virtual-channel-id = <0>;
		qcom,mdss-dsi-stream = <0>;
		qcom,mdss-dsi-panel-width = <720>;
		qcom,mdss-dsi-panel-height = <1280>;
		qcom,mdss-dsi-h-front-porch = <84>;
		qcom,mdss-dsi-h-back-porch = <84>;
		qcom,mdss-dsi-h-pulse-width = <12>;
		qcom,mdss-dsi-h-sync-skew = <0>;
		qcom,mdss-dsi-v-back-porch = <20>;
		qcom,mdss-dsi-v-front-porch = <20>;
		qcom,mdss-dsi-v-pulse-width = <3>;
		qcom,mdss-dsi-h-left-border = <0>;
		qcom,mdss-dsi-h-right-border = <0>;
		qcom,mdss-dsi-v-top-border = <0>;
		qcom,mdss-dsi-v-bottom-border = <0>;
		qcom,mdss-dsi-bpp = <24>;
		qcom,mdss-dsi-underflow-color = <0x00>;
		qcom,mdss-dsi-border-color = <0>;
		qcom,mdss-dsi-color-order = "rgb_swap_rgb";
		qcom,mdss-dsi-on-command = [29 01 00 00 00 00 05 FF AA 55 A5 80
				29 01 00 00 00 00 03 6F 11 00
				29 01 00 00 00 00 03 F7 20 00
				29 01 00 00 00 00 02 6F 06
				29 01 00 00 00 00 02 F7 A0
				29 01 00 00 00 00 02 6F 19
				29 01 00 00 00 00 02 F7 12
				29 01 00 00 00 00 02 6F 02
				29 01 00 00 00 00 02 F7 47
				29 01 00 00 00 00 02 6F 17
				29 01 00 00 00 00 02 F4 70
				29 01 00 00 00 00 02 6F 01
				29 01 00 00 00 00 02 F9 46
				29 01 00 00 00 00 06 F0 55 AA 52 08 00
				29 01 00 00 00 00 02 B1 60
				29 01 00 00 00 00 06 BD 01 A0 10 10 01
				29 01 00 00 00 00 05 B8 01 02 0C 02
				29 01 00 00 00 00 03 BB 11 11
				29 01 00 00 00 00 03 BC 00 00
				29 01 00 00 00 00 02 B6 04
				29 01 00 00 00 00 02 C8 80
				29 01 00 00 00 00 11 CC 40 36 BA 00 00 00 00 00 00 00 00 00 00 50 FF 00
				29 01 00 00 00 00 11 D1 00 02 04 06 08 0C 0E 10 10 10 0E 0C 08 06 02 00
				29 01 00 00 00 00 0D D7 24 23 22 21 00 00 00 00 00 00 00 00
				29 01 00 00 00 00 0E D8 00 00 00 00 00 00 00 00 00 00 23 22 00
				29 01 00 00 00 00 06 F0 55 AA 52 08 01
				29 01 00 00 00 00 03 B0 09 09
				29 01 00 00 00 00 03 B1 09 09
				29 01 00 00 00 00 03 BC 80 00
				29 01 00 00 00 00 03 BD 80 00
				29 01 00 00 00 00 02 CA 00
				29 01 00 00 00 00 02 C0 0C
				29 01 00 00 00 00 03 B5 03 03
				29 01 00 00 00 00 03 B3 19 19
				29 01 00 00 00 00 03 B4 19 19
				29 01 00 00 00 00 03 B9 26 26
				29 01 00 00 00 00 03 BA 24 24
				29 01 00 00 00 00 06 F0 55 AA 52 08 02
				29 01 00 00 00 00 02 EE 01
				29 01 00 00 00 00 11 B0 00 43 00 4A 00 58 00 66 00 73 00 89 00 9F 00 C4
				29 01 00 00 00 00 11 B1 00 E4 01 1B 01 48 01 94 01 D3 01 D5 02 11 02 55
				29 01 00 00 00 00 11 B2 02 7F 02 BE 02 E6 03 1F 03 44 03 75 03 93 03 BC
				29 01 00 00 00 00 05 B3 03 EA 03 FF
				29 01 00 00 00 00 02 C0 04
				29 01 00 00 00 00 06 F0 55 AA 52 08 06
				29 01 00 00 00 00 03 B0 10 12
				29 01 00 00 00 00 03 B1 14 16
				29 01 00 00 00 00 03 B2 00 02
				29 01 00 00 00 00 03 B3 31 31
				29 01 00 00 00 00 03 B4 31 34
				29 01 00 00 00 00 03 B5 34 34
				29 01 00 00 00 00 03 B6 34 31
				29 01 00 00 00 00 03 B7 31 31
				29 01 00 00 00 00 03 B8 31 31
				29 01 00 00 00 00 03 B9 2D 2E
				29 01 00 00 00 00 03 BA 2E 2D
				29 01 00 00 00 00 03 BB 31 31
				29 01 00 00 00 00 03 BC 31 31
				29 01 00 00 00 00 03 BD 31 34
				29 01 00 00 00 00 03 BF 34 31
				29 01 00 00 00 00 03 C0 31 31
				29 01 00 00 00 00 03 C1 03 01
				29 01 00 00 00 00 03 C2 17 15
				29 01 00 00 00 00 03 C3 13 11
				29 01 00 00 00 00 03 E5 31 31
				29 01 00 00 00 00 03 C4 17 15
				29 01 00 00 00 00 03 C5 13 11
				29 01 00 00 00 00 03 C6 03 01
				29 01 00 00 00 00 03 C7 31 31
				29 01 00 00 00 00 03 C8 31 34
				29 01 00 00 00 00 03 C9 34 34
				29 01 00 00 00 00 03 CA 34 31
				29 01 00 00 00 00 03 CB 31 31
				29 01 00 00 00 00 03 CC 31 31
				29 01 00 00 00 00 03 CD 2E 2D
				29 01 00 00 00 00 03 CE 2D 2E
				29 01 00 00 00 00 03 CF 31 31
				29 01 00 00 00 00 03 D0 31 31
				29 01 00 00 00 00 03 D1 31 34
				29 01 00 00 00 00 03 D2 34 34
				29 01 00 00 00 00 03 D3 34 31
				29 01 00 00 00 00 03 D4 31 31
				29 01 00 00 00 00 03 D5 00 02
				29 01 00 00 00 00 03 D6 10 12
				29 01 00 00 00 00 03 D7 14 16
				29 01 00 00 00 00 03 E6 32 32
				29 01 00 00 00 00 06 D8 00 00 00 00 00
				29 01 00 00 00 00 06 D9 00 00 00 00 00
				29 01 00 00 00 00 02 E7 00
				29 01 00 00 00 00 06 F0 55 AA 52 08 05
				29 01 00 00 00 00 02 ED 30
				29 01 00 00 00 00 03 B0 17 06
				29 01 00 00 00 00 02 B8 00
				29 01 00 00 00 00 02 C0 0D
				29 01 00 00 00 00 02 C1 0B
				29 01 00 00 00 00 02 C2 23
				29 01 00 00 00 00 02 C3 40
				29 01 00 00 00 00 02 C4 84
				29 01 00 00 00 00 02 C5 82
				29 01 00 00 00 00 02 C6 82
				29 01 00 00 00 00 02 C7 80
				29 01 00 00 00 00 03 C8 0B 30
				29 01 00 00 00 00 03 C9 05 10
				29 01 00 00 00 00 03 CA 01 10
				29 01 00 00 00 00 03 CB 01 10
				29 01 00 00 00 00 06 D1 03 05 05 07 00
				29 01 00 00 00 00 06 D2 03 05 09 03 00
				29 01 00 00 00 00 06 D3 00 00 6A 07 10
				29 01 00 00 00 00 06 D4 30 00 6A 07 10
				29 01 00 00 00 00 06 F0 55 AA 52 08 03
				29 01 00 00 00 00 03 B0 00 00
				29 01 00 00 00 00 03 B1 00 00
				29 01 00 00 00 00 06 B2 05 00 0A 00 00
				29 01 00 00 00 00 06 B3 05 00 0A 00 00
				29 01 00 00 00 00 06 B4 05 00 0A 00 00
				29 01 00 00 00 00 06 B5 05 00 0A 00 00
				29 01 00 00 00 00 06 B6 02 00 0A 00 00
				29 01 00 00 00 00 06 B7 02 00 0A 00 00
				29 01 00 00 00 00 06 B8 02 00 0A 00 00
				29 01 00 00 00 00 06 B9 02 00 0A 00 00
				29 01 00 00 00 00 06 BA 53 00 0A 00 00
				29 01 00 00 00 00 06 BB 53 00 0A 00 00
				29 01 00 00 00 00 06 BC 53 00 0A 00 00
				29 01 00 00 00 00 06 BD 53 00 0A 00 00
				29 01 00 00 00 00 02 C4 60
				29 01 00 00 00 00 02 C5 40
				29 01 00 00 00 00 02 C6 64
				29 01 00 00 00 00 02 6F 11
				29 01 00 00 00 00 02 F3 01
				29 01 00 00 00 00 06 F0 55 AA 52 08 00
				29 01 00 00 00 00 05 E6 FF FF FB FB
				29 01 00 00 00 00 03 D9 02 09
				15 01 00 00 00 00 02 55 81
				15 01 00 00 00 00 02 53 24
				15 01 00 00 00 00 02 51 00
				15 01 00 00 00 00 02 5E 28
				05 01 00 00 78 00 02 11 00
				05 01 00 00 16 00 02 29 00];
		qcom,mdss-dsi-off-command = [05 01 00 00 32 00 02 28 00
			05 01 00 00 78 00 02 10 00];
		qcom,mdss-dsi-on-command-state = "dsi_lp_mode";
		qcom,mdss-dsi-off-command-state = "dsi_hs_mode";
		qcom,mdss-dsi-h-sync-pulse = <1>;
		qcom,mdss-dsi-traffic-mode = "burst_mode";
		qcom,mdss-dsi-lane-map = "lane_map_0123";
		qcom,mdss-dsi-bllp-eof-power-mode;
		qcom,mdss-dsi-bllp-power-mode;
		qcom,mdss-dsi-lane-0-state;
		qcom,mdss-dsi-lane-1-state;
		qcom,mdss-dsi-lane-2-state;
		qcom,mdss-dsi-lane-3-state;
		qcom,mdss-dsi-panel-timings = [7a 1a 12 00 3e 42 16 1e 14 03 04 00];
		qcom,mdss-dsi-t-clk-post = <0x04>;
		qcom,mdss-dsi-t-clk-pre = <0x1a>;
		qcom,mdss-dsi-bl-min-level = <6>;
		qcom,mdss-dsi-bl-max-level = <250>;
		qcom,mdss-dsi-dma-trigger = "trigger_sw";
		qcom,mdss-dsi-mdp-trigger = "none";
		qcom,mdss-dsi-bl-pmic-control-type = "bl_ctrl_dcs";
		qcom,panel-inverse-off-cmds = [05 01 00 00 00 00 02 20 00];
		qcom,panel-inverse-on-cmds = [05 01 00 00 00 00 02 21 00];
		qcom,inverse-on-cmds-dsi-state = "dsi_lp_mode";
		qcom,inverse-off-cmds-dsi-state = "dsi_lp_mode";
		qcom,panel-cabc-ui-cmds = [15 01 00 00 00 00 02 55 81
					15 01 00 00 00 00 02 53 24];
		qcom,panel-cabc-video-cmds = [15 01 00 00 00 00 02 55 83
					15 01 00 00 00 00 02 53 2C];
		qcom,cabc-ui-cmds-dsi-state = "dsi_lp_mode";
		qcom,cabc-video-cmds-dsi-state = "dsi_lp_mode";
		qcom,panel-dot-inversion-mode-cmds = [29 01 00 00 00 00 06 F0 55 AA 52 08 00
				29 01 00 00 00 00 03 BC 01 01];
		qcom,panel-column-inversion-mode-cmds = [29 01 00 00 00 00 06 F0 55 AA 52 08 00
				29 01 00 00 00 00 03 BC 00 00];
		qcom,dot-inversion-cmds-dsi-state = "dsi_lp_mode";
		qcom,column-inversion-cmds-dsi-state = "dsi_lp_mode";
		qcom,mdss-dsi-lp11-init;
		qcom,mdss-pan-physical-width-dimension = <62>;
		qcom,mdss-pan-physical-height-dimension = <110>;
		qcom,mdss-dsi-reset-sequence = <1 1>, <0 20>, <1 20>;

	};
};
