/* Copyright (c) 2013, The Linux Foundation. All rights reserved.
 *
 * This program is free software; you can redistribute it and/or modify
 * it under the terms of the GNU General Public License version 2 and
 * only version 2 as published by the Free Software Foundation.
 *
 * This program is distributed in the hope that it will be useful,
 * but WITHOUT ANY WARRANTY; without even the implied warranty of
 * MERCHANTABILITY or FITNESS FOR A PARTICULAR PURPOSE.  See the
 * GNU General Public License for more details.
 */

/*---------------------------------------------------------------------------
 * This file is autogenerated file using gcdb parser. Please do not edit it.
 * Update input XML file to add a new entry or update variable in this file
 * VERSION = "1.0"
 *---------------------------------------------------------------------------*/
&mdss_mdp {
	dsi_boe_otm1284a_5_720pxa_video: qcom,mdss_dsi_boe_otm1284a_5_720pxa_video {
		qcom,mdss-dsi-panel-name = "BOE_OTM1284A_5_720P_VIDEO";
		qcom,cont-splash-enabled;
		qcom,mdss-dsi-panel-controller = <&mdss_dsi0>;
		qcom,mdss-dsi-panel-type = "dsi_video_mode";
		qcom,mdss-dsi-panel-destination = "display_1";
		qcom,mdss-dsi-panel-clockrate = <428000000>;
		qcom,mdss-dsi-panel-framerate = <60>;
		qcom,mdss-dsi-virtual-channel-id = <0>;
		qcom,mdss-dsi-stream = <0>;
		qcom,mdss-dsi-panel-width = <720>;
		qcom,mdss-dsi-panel-height = <1280>;
		qcom,mdss-dsi-h-front-porch = <84>;
		qcom,mdss-dsi-h-back-porch = <84>;
		qcom,mdss-dsi-h-pulse-width = <12>;
		qcom,mdss-dsi-h-sync-skew = <0>;
		qcom,mdss-dsi-v-back-porch = <20>;
		qcom,mdss-dsi-v-front-porch = <20>;
		qcom,mdss-dsi-v-pulse-width = <3>;
		qcom,mdss-dsi-h-left-border = <0>;
		qcom,mdss-dsi-h-right-border = <0>;
		qcom,mdss-dsi-v-top-border = <0>;
		qcom,mdss-dsi-v-bottom-border = <0>;
		qcom,mdss-dsi-bpp = <24>;
		qcom,mdss-dsi-underflow-color = <0x00>;
		qcom,mdss-dsi-border-color = <0>;
		qcom,mdss-dsi-color-order = "rgb_swap_rgb";
		qcom,mdss-dsi-on-command = [29 01 00 00 00 00 02 00 00
			29 01 00 00 00 00 04 FF 12 84 01
			29 01 00 00 00 00 02 00 80
			29 01 00 00 00 00 03 FF 12 84
			29 01 00 00 00 00 02 00 91
			29 01 00 00 00 00 02 B0 9A
			29 01 00 00 00 00 02 00 92
			29 01 00 00 00 00 03 FF 30 02
			29 01 00 00 00 00 02 00 80
			29 01 00 00 00 00 0A C0 00 64 00 0F 11 00 64 0F 11
			29 01 00 00 00 00 02 00 90
			29 01 00 00 00 00 07 C0 00 5F 00 01 00 04
			29 01 00 00 00 00 02 00 A4
			29 01 00 00 00 00 02 C0 00
			29 01 00 00 00 00 02 00 B3
			29 01 00 00 00 00 04 C0 00 50 48
			29 01 00 00 00 00 02 00 81
			29 01 00 00 00 00 02 C1 55
			29 01 00 00 00 00 02 00 90
			29 01 00 00 00 00 05 F5 02 11 02 15
			29 01 00 00 00 00 02 00 90
			29 01 00 00 00 00 02 C5 50
			29 01 00 00 00 00 02 00 94
			29 01 00 00 00 00 02 C5 66
			29 01 00 00 00 00 02 00 B2
			29 01 00 00 00 00 03 F5 00 00
			29 01 00 00 00 00 02 00 B4
			29 01 00 00 00 00 03 F5 00 00
			29 01 00 00 00 00 02 00 B6
			29 01 00 00 00 00 03 F5 00 00
			29 01 00 00 00 00 02 00 B8
			29 01 00 00 00 00 03 F5 00 00
			29 01 00 00 00 00 02 00 B4
			29 01 00 00 00 00 02 C5 CC
			29 01 00 00 00 00 02 00 A0
			29 01 00 00 00 00 0F C4 05 10 06 02 05 15 10 05 10 07 02 05 15 10
			29 01 00 00 00 00 02 00 B0
			29 01 00 00 00 00 03 C4 00 00
			29 01 00 00 00 00 02 00 91
			29 01 00 00 00 00 03 C5 19 52
			29 01 00 00 00 00 02 00 00
			29 01 00 00 00 00 03 D8 8C 8C
			29 01 00 00 00 00 02 00 B3
			29 01 00 00 00 00 02 C5 84
			29 01 00 00 00 00 02 00 BB
			29 01 00 00 00 00 02 C5 8A
			29 01 00 00 00 00 02 00 B2
			29 01 00 00 00 00 02 C5 40
			29 01 00 00 00 00 02 00 81
			29 01 00 00 00 00 03 C4 82 0A
			29 01 00 00 00 00 02 00 88
			29 01 00 00 00 00 02 C4 80
			29 01 00 00 00 00 02 00 C6
			29 01 00 00 00 00 02 B0 03
			29 01 00 00 00 00 02 00 B1
			29 01 00 00 00 00 02 C6 02
			29 01 00 00 00 00 02 00 B4
			29 01 00 00 00 00 02 C6 10
			29 01 00 00 00 00 02 00 00
			29 01 00 00 00 00 15 E1 00 14 21 2F 3E 4D 4F 7B 6D 87 7B 65 77 53 4F 41 31 1D 0A 00
			29 01 00 00 00 00 02 00 00
			29 01 00 00 00 00 15 E2 00 14 21 2F 3E 4D 4F 7B 6D 87 7B 65 77 53 4F 41 31 1D 0A 00
			29 01 00 00 00 00 02 00 00
			29 01 00 00 00 00 22 EC 40 44 34 44 44 44 44 43 44 44 44 43 44 44 44 43 44 44 44 43 44 44 44 43 44 44 44 34 44 44 44 34 05
			29 01 00 00 00 00 02 00 00
			29 01 00 00 00 00 22 ED 40 34 44 44 34 44 44 43 44 44 43 44 34 44 44 34 44 44 43 44 44 43 44 34 44 44 34 44 44 43 44 44 03
			29 01 00 00 00 00 02 00 00
			29 01 00 00 00 00 22 EE 40 44 44 44 44 44 43 44 44 44 44 44 44 44 44 44 44 44 44 44 44 44 44 44 44 44 44 44 44 44 44 44 05
			29 01 00 00 00 00 02 00 80
			29 01 00 00 00 00 0C CB 00 00 00 00 00 00 00 00 00 00 00
			29 01 00 00 00 00 02 00 90
			29 01 00 00 00 00 10 CB 00 00 00 00 00 00 00 00 00 00 00 00 00 00 00
			29 01 00 00 00 00 02 00 A0
			29 01 00 00 00 00 10 CB 00 00 00 00 00 00 00 00 00 00 00 00 00 00 00
			29 01 00 00 00 00 02 00 B0
			29 01 00 00 00 00 10 CB 00 00 00 00 00 00 00 00 00 00 00 00 00 00 00
			29 01 00 00 00 00 02 00 C0
			29 01 00 00 00 00 10 CB 05 05 05 05 05 05 05 05 05 00 00 00 00 00 00
			29 01 00 00 00 00 02 00 D0
			29 01 00 00 00 00 10 CB 00 00 00 05 05 05 05 05 05 05 05 05 05 05 05
			29 01 00 00 00 00 02 00 E0
			29 01 00 00 00 00 0F CB 05 00 00 00 00 00 00 00 00 00 05 05 05 05
			29 01 00 00 00 00 02 00 F0
			29 01 00 00 00 00 0C CB FF FF FF FF FF FF FF FF FF FF FF
			29 01 00 00 00 00 02 00 80
			29 01 00 00 00 00 10 CC 2D 2D 0A 0C 0E 10 00 00 00 00 00 00 00 00 00
			29 01 00 00 00 00 02 00 90
			29 01 00 00 00 00 10 CC 00 00 00 2E 2E 02 04 2D 2D 09 0B 0D 0F 00 00
			29 01 00 00 00 00 02 00 A0
			29 01 00 00 00 00 0F CC 00 00 00 00 00 00 00 00 00 00 2E 2E 01 03
			29 01 00 00 00 00 02 00 B0
			29 01 00 00 00 00 10 CC 2D 2E 0F 0D 0B 09 00 00 00 00 00 00 00 00 00
			29 01 00 00 00 00 02 00 C0
			29 01 00 00 00 00 10 CC 00 00 00 2E 2D 03 01 2D 2E 10 0E 0C 0A 00 00
			29 01 00 00 00 00 02 00 D0
			29 01 00 00 00 00 0F CC 00 00 00 00 00 00 00 00 00 00 2E 2D 04 02
			29 01 00 00 00 00 02 00 80
			29 01 00 00 00 00 0D CE 8D 03 29 8C 03 29 8B 03 29 8A 03 29
			29 01 00 00 00 00 02 00 90
			29 01 00 00 00 00 0F CE 00 00 00 00 00 00 00 00 00 00 00 00 00 00
			29 01 00 00 00 00 02 00 A0
			29 01 00 00 00 00 0F CE 38 0B 8B 00 8D 29 00 38 0A 8B 01 8D 29 00
			29 01 00 00 00 00 02 00 B0
			29 01 00 00 00 00 0F CE 38 09 8B 02 8D 29 00 38 08 8B 03 8D 29 00
			29 01 00 00 00 00 02 00 C0
			29 01 00 00 00 00 0F CE 38 07 8B 04 8D 29 00 38 06 8B 05 8D 29 00
			29 01 00 00 00 00 02 00 D0
			29 01 00 00 00 00 0F CE 38 05 8B 06 8D 29 00 38 04 8B 07 8D 29 00
			29 01 00 00 00 00 02 00 80
			29 01 00 00 00 00 0F CF 00 00 00 00 00 00 00 00 00 00 00 00 00 00
			29 01 00 00 00 00 02 00 90
			29 01 00 00 00 00 0F CF 00 00 00 00 00 00 00 00 00 00 00 00 00 00
			29 01 00 00 00 00 02 00 A0
			29 01 00 00 00 00 0F CF 00 00 00 00 00 00 00 00 00 00 00 00 00 00
			29 01 00 00 00 00 02 00 B0
			29 01 00 00 00 00 0F CF 00 00 00 00 00 00 00 00 00 00 00 00 00 00
			29 01 00 00 00 00 02 00 C0
			29 01 00 00 00 00 0C CF 01 01 20 20 00 00 01 01 00 00 00
			29 01 00 00 00 00 02 00 B5
			29 01 00 00 00 00 07 C5 3C 01 FF 3C 01 FF
			29 01 00 00 00 00 02 00 A0
			29 01 00 00 00 00 0D D6 01 00 01 00 01 7F 01 FD 01 FD 01 FD
			29 01 00 00 00 00 02 00 B0
			29 01 00 00 00 00 0D D6 01 FD 15 FD 15 FD 15 FD 01 FD 01 FD
			29 01 00 00 00 00 02 00 C0
			29 01 00 00 00 00 0D D6 54 11 00 A9 11 A9 A9 11 A9 A9 11 A9
			29 01 00 00 00 00 02 00 D0
			29 01 00 00 00 00 07 D6 A9 11 A9 A9 11 A9
			29 01 00 00 00 00 02 00 E0
			29 01 00 00 00 00 0D D6 54 11 54 54 11 54 54 11 54 54 11 54
			29 01 00 00 00 00 02 00 F0
			29 01 00 00 00 00 07 D6 54 11 54 54 11 54
			29 01 00 00 00 00 02 00 80
			29 01 00 00 00 00 02 D6 00
			29 01 00 00 00 00 02 00 D0
			29 01 00 00 00 00 03 D9 AA AA
			29 01 00 00 00 00 02 00 00
			29 01 00 00 00 00 04 FF FF FF FF
			29 01 00 00 00 00 02 00 00
			29 01 00 00 00 00 02 81 80
			15 01 00 00 00 00 02 51 00
			15 01 00 00 00 00 02 53 24
			15 01 00 00 00 00 02 55 01
			15 01 00 00 00 00 02 5E 28
			05 01 00 00 78 00 02 11 00
			05 01 00 00 14 00 02 29 00];
		qcom,mdss-dsi-off-command = [05 01 00 00 14 00 02 28 00
			05 01 00 00 78 00 02 10 00];
		qcom,mdss-dsi-on-command-state = "dsi_lp_mode";
		qcom,mdss-dsi-off-command-state = "dsi_hs_mode";
		qcom,mdss-dsi-h-sync-pulse = <1>;
		qcom,mdss-dsi-traffic-mode = "burst_mode";
		qcom,mdss-dsi-lane-map = "lane_map_0123";
		qcom,mdss-dsi-bllp-eof-power-mode;
		qcom,mdss-dsi-bllp-power-mode;
		qcom,mdss-dsi-lane-0-state;
		qcom,mdss-dsi-lane-1-state;
		qcom,mdss-dsi-lane-2-state;
		qcom,mdss-dsi-lane-3-state;
		qcom,mdss-dsi-panel-timings = [7a 1a 12 00 3e 42 16 1e 14 03 04 00];
		qcom,mdss-dsi-t-clk-post = <0x04>;
		qcom,mdss-dsi-t-clk-pre = <0x1a>;
		qcom,mdss-dsi-bl-min-level = <6>;
		qcom,mdss-dsi-bl-max-level = <250>;
		qcom,mdss-dsi-dma-trigger = "trigger_sw";
		qcom,mdss-dsi-mdp-trigger = "none";
		qcom,mdss-dsi-bl-pmic-control-type = "bl_ctrl_dcs";
		qcom,panel-inverse-off-cmds = [05 01 00 00 00 00 02 20 00];
		qcom,panel-inverse-on-cmds = [05 01 00 00 00 00 02 21 00];
		qcom,inverse-on-cmds-dsi-state = "dsi_lp_mode";
		qcom,inverse-off-cmds-dsi-state = "dsi_lp_mode";
		qcom,panel-cabc-ui-cmds = [15 01 00 00 00 00 02 55 01
			15 01 00 00 00 00 02 53 24];
		qcom,panel-cabc-video-cmds = [15 01 00 00 00 00 02 55 03
			15 01 00 00 00 00 02 53 2C];
		qcom,cabc-ui-cmds-dsi-state = "dsi_lp_mode";
		qcom,cabc-video-cmds-dsi-state = "dsi_lp_mode";
		qcom,panel-dot-inversion-mode-cmds = [29 01 00 00 00 00 02 00 00
				29 01 00 00 00 00 04 FF 12 84 01
				29 01 00 00 00 00 02 00 80
				29 01 00 00 00 00 03 FF 12 84
				29 01 00 00 00 00 02 00 B4
				29 01 00 00 00 00 02 C0 00
				29 01 00 00 00 00 02 00 00
				29 01 00 00 00 00 04 FF FF FF FF];
		qcom,panel-column-inversion-mode-cmds = [29 01 00 00 00 00 02 00 00
				29 01 00 00 00 00 04 FF 12 84 01
				29 01 00 00 00 00 02 00 80
				29 01 00 00 00 00 03 FF 12 84
				29 01 00 00 00 00 02 00 B4
				29 01 00 00 00 00 02 C0 50
				29 01 00 00 00 00 02 00 00
				29 01 00 00 00 00 04 FF FF FF FF];
		qcom,dot-inversion-cmds-dsi-state = "dsi_lp_mode";
		qcom,column-inversion-cmds-dsi-state = "dsi_lp_mode";
		qcom,mdss-dsi-lp11-init;
		qcom,mdss-pan-physical-width-dimension = <62>;
		qcom,mdss-pan-physical-height-dimension = <110>;
		qcom,mdss-dsi-reset-sequence = <1 1>, <0 20>, <1 20>;

	};
};
