 / {
        huawei_fac_info {
                  compatible = "huawei,hw_fac_info";
                  fac,product_name = "HUAWEI SCL-L03";
                  fac,hardware_ver = "HL1SCALETM";
                  fac,software_ver = "MSM8909_SCL_L03_VA";
                  status = "ok";
        };
};
