/* Copyright (c) 2013, The Linux Foundation. All rights reserved.
 *
 * This program is free software; you can redistribute it and/or modify
 * it under the terms of the GNU General Public License version 2 and
 * only version 2 as published by the Free Software Foundation.
 *
 * This program is distributed in the hope that it will be useful,
 * but WITHOUT ANY WARRANTY; without even the implied warranty of
 * MERCHANTABILITY or FITNESS FOR A PARTICULAR PURPOSE.  See the
 * GNU General Public License for more details.
 */

/*---------------------------------------------------------------------------
 * This file is autogenerated file using gcdb parser. Please do not edit it.
 * Update input XML file to add a new entry or update variable in this file
 * VERSION = "1.0"
 *---------------------------------------------------------------------------*/
&mdss_mdp {
	dsi_boe_nt35512_4p5_fwvga_video: qcom,mdss_dsi_boe_nt35512_4p5_fwvga_video {
		qcom,mdss-dsi-panel-name = "BOE_NT35512_4P5_FWVGA_VIDEO";
		qcom,cont-splash-enabled;
		qcom,mdss-dsi-panel-controller = <&mdss_dsi0>;
		qcom,mdss-dsi-panel-type = "dsi_video_mode";
		qcom,mdss-dsi-panel-destination = "display_1";
		qcom,mdss-dsi-panel-clockrate = <429320000>;
		qcom,mdss-dsi-panel-framerate = <60>;
		qcom,mdss-dsi-virtual-channel-id = <0>;
		qcom,mdss-dsi-stream = <0>;
		qcom,mdss-dsi-panel-width = <480>;
		qcom,mdss-dsi-panel-height = <854>;
		qcom,mdss-dsi-h-front-porch = <80>;
		qcom,mdss-dsi-h-back-porch = <80>;
		qcom,mdss-dsi-h-pulse-width = <24>;
		qcom,mdss-dsi-h-sync-skew = <0>;
		qcom,mdss-dsi-v-back-porch = <16>;
		qcom,mdss-dsi-v-front-porch = <24>;
		qcom,mdss-dsi-v-pulse-width = <4>;
		qcom,mdss-dsi-h-left-border = <0>;
		qcom,mdss-dsi-h-right-border = <0>;
		qcom,mdss-dsi-v-top-border = <0>;
		qcom,mdss-dsi-v-bottom-border = <0>;
		qcom,mdss-dsi-bpp = <24>;
		qcom,mdss-dsi-underflow-color = <0xff>;
		qcom,mdss-dsi-border-color = <0>;
		qcom,mdss-dsi-color-order = "rgb_swap_rgb";
		qcom,mdss-dsi-pixel-packing = "tight";
		qcom,mdss-dsi-on-command = [29 01 00 00 00 00 05 FF AA 55 69 10
			29 01 00 00 00 00 0B F5 02 04 04 04 04 04 06 06 08 0A
			29 01 00 00 00 00 05 FF AA 55 69 00
			29 01 00 00 00 00 05 FF AA 55 A5 80
			29 01 00 00 00 00 0D F8 00 00 33 0F 0F 20 00 01 00 00 24 80
			29 01 00 00 00 00 06 F5 11 11 11 22 43
			29 01 00 00 00 00 06 F0 55 AA 52 08 01
			29 01 00 00 00 00 04 B6 34 34 34
			29 01 00 00 00 00 04 B0 0F 0F 0F
			29 01 00 00 00 00 04 B7 34 34 34
			29 01 00 00 00 00 04 B1 0F 0F 0F
			29 01 00 00 00 00 04 B8 34 34 34
			29 01 00 00 00 00 04 B2 01 01 01
			29 01 00 00 00 00 04 B9 26 24 24
			29 01 00 00 00 00 04 B3 04 04 04
			29 01 00 00 00 00 04 BA 26 24 24
			29 01 00 00 00 00 04 B5 09 09 09
			29 01 00 00 00 00 04 BC 00 62 00
			29 01 00 00 00 00 04 BD 00 62 00
			29 01 00 00 00 00 02 BF 01
			29 01 00 00 00 00 35 D1 00 01 00 09 00 27 00 40 00 56 00 75 00 8E 00 B8 00 E1 01 1D 01 4E 01 9C 01 DD 01 DF 02 1C 02 5B 02 81 02 B6 02 D8 03 0C 03 24 03 51 03 61 03 89 03 9A 03 A4
			29 01 00 00 00 00 35 D2 00 55 00 5F 00 70 00 7F 00 89 00 A0 00 B5 00 DA 00 FB 01 30 01 5C 01 A5 01 E3 01 E5 02 1F 02 5D 02 83 02 BA 02 DF 03 21 03 41 03 63 03 79 03 94 03 AB 03 AF
			29 01 00 00 00 00 35 D3 00 AF 00 B5 00 BF 00 C9 00 D1 00 E2 00 EE 01 09 01 22 01 4E 01 74 01 B6 01 EF 01 F0 02 28 02 63 02 89 02 BE 02 E3 03 25 03 3E 03 52 03 6A 03 79 03 80 03 AE
			29 01 00 00 00 00 35 D4 00 01 00 09 00 27 00 40 00 56 00 75 00 8E 00 B8 00 E1 01 1D 01 4E 01 9C 01 DD 01 DF 02 1C 02 5B 02 81 02 B6 02 D8 03 0C 03 24 03 51 03 61 03 89 03 9A 03 A4
			29 01 00 00 00 00 35 D5 00 55 00 5F 00 70 00 7F 00 89 00 A0 00 B5 00 DA 00 FB 01 30 01 5C 01 A5 01 E3 01 E5 02 1F 02 5D 02 83 02 BA 02 DF 03 21 03 41 03 63 03 79 03 94 03 AB 03 AF
			29 01 00 00 00 00 35 D6 00 AF 00 B5 00 BF 00 C9 00 D1 00 E2 00 EE 01 09 01 22 01 4E 01 74 01 B6 01 EF 01 F0 02 28 02 63 02 89 02 BE 02 E3 03 25 03 3E 03 52 03 6A 03 79 03 80 03 AE
			29 01 00 00 00 00 06 F0 55 AA 52 08 00
			29 01 00 00 00 00 03 E0 00 01
			29 01 00 00 00 00 0B E3 E2 E1 DF DD DA D7 CC C9 C0 B8
			29 01 00 00 00 00 02 B5 6B
			29 01 00 00 00 00 02 B6 03
			29 01 00 00 00 00 03 B7 00 00
			29 01 00 00 00 00 05 B8 01 07 07 07
			29 01 00 00 00 00 02 BA 01
			29 01 00 00 00 00 04 BB 2C 2C 2C
			29 01 00 00 00 00 04 BC 00 00 00
			29 01 00 00 00 00 06 BD 01 6C 1D 1D 00
			29 01 00 00 00 00 06 BE 01 84 07 31 00
			29 01 00 00 00 00 06 BF 01 84 07 31 00
			29 01 00 00 00 00 04 CC 03 00 00
			29 01 00 00 00 00 03 B1 F8 06
			15 01 00 00 00 00 02 36 00
			15 01 00 00 00 00 02 51 00
			15 01 00 00 00 00 02 53 24
			15 01 00 00 00 00 02 55 01
			15 01 00 00 00 00 02 5E 28
			05 01 00 00 78 00 02 11 00
			05 01 00 00 14 00 02 29 00];
		qcom,mdss-dsi-off-command = [05 01 00 00 14 00 02 28 00
					05 01 00 00 78 00 02 10 00];
		qcom,mdss-dsi-on-command-state = "dsi_lp_mode";
		qcom,mdss-dsi-off-command-state = "dsi_hs_mode";
		qcom,mdss-dsi-h-sync-pulse = <1>;
		qcom,mdss-dsi-traffic-mode = "burst_mode";
		qcom,mdss-dsi-lane-map = "lane_map_3012";
		qcom,mdss-dsi-bllp-eof-power-mode;
		qcom,mdss-dsi-bllp-power-mode;
		qcom,mdss-dsi-hfpPowerMode;
		qcom,mdss-dsi-hbpPowerMode;
		qcom,mdss-dsi-hsaPowerMode;
		qcom,mdss-dsi-lane-0-state;
		qcom,mdss-dsi-lane-1-state;
		qcom,mdss-dsi-panel-timings = [7a 1a 12 00 3e 42 16 1e 14 03 04 00];
		qcom,mdss-dsi-t-clk-post = <0x04>;
		qcom,mdss-dsi-t-clk-pre = <0x19>;
		qcom,mdss-dsi-bl-min-level = <10>;
		qcom,mdss-dsi-bl-max-level = <250>;
		qcom,mdss-dsi-dma-trigger = "trigger_sw";
		qcom,mdss-dsi-mdp-trigger = "none";
		qcom,mdss-dsi-bl-pmic-control-type = "bl_ctrl_dcs";
		qcom,panel-inverse-off-cmds = [05 01 00 00 00 00 02 20 00];
		qcom,panel-inverse-on-cmds = [05 01 00 00 00 00 02 21 00];
		qcom,inverse-on-cmds-dsi-state = "dsi_lp_mode";
		qcom,inverse-off-cmds-dsi-state = "dsi_lp_mode";
		qcom,panel-cabc-ui-cmds = [29 01 00 00 00 00 06 F0 55 AA 52 08 00
					29 01 00 00 00 00 0B E3 E5 E3 E1 E0 DC D7 D0 CC C8 C4
					15 01 00 00 00 00 02 53 24];
		qcom,panel-cabc-video-cmds = [29 01 00 00 00 00 06 F0 55 AA 52 08 00
					29 01 00 00 00 00 0B E3 F0 D2 C3 B4 A5 96 87 87 87 81
					15 01 00 00 00 00 02 53 2C];
		qcom,cabc-ui-cmds-dsi-state = "dsi_hs_mode";
		qcom,cabc-video-cmds-dsi-state = "dsi_hs_mode";
		qcom,panel-dot-inversion-mode-cmds = [29 01 00 00 00 00 06 F0 55 AA 52 08 00
				29 01 00 00 00 00 02 BC 01];
		qcom,panel-column-inversion-mode-cmds = [29 01 00 00 00 00 06 F0 55 AA 52 08 00
				29 01 00 00 00 00 02 BC 00];
		qcom,dot-inversion-cmds-dsi-state = "dsi_lp_mode";
		qcom,column-inversion-cmds-dsi-state = "dsi_lp_mode";
		qcom,mdss-dsi-lp11-init;
		qcom,mdss-pan-physical-width-dimension = <55>;
		qcom,mdss-pan-physical-height-dimension = <99>;
		huawei,delaytime-before-bl = <80>;
		qcom,mdss-dsi-reset-sequence = <1 1>, <0 20>, <1 120>;

	};
};
