/ {
    huawei_audio_info {
        compatible = "huawei,hw_audio_info";
        product-identifier = "y538-a1";
        status = "ok";
        builtin-master-mic-exist;
        builtin-2nd-mic-exist;
        hand_held_dual_mic_strategy;
        loud_speaker_dual_mic_strategy;
        huawei,hac_gpio = <&msm_gpio 99 0x0>;
        speaker-pa = "tfa9895";
    };
};
&soc {
    sound {
        qcom,ext_boost_en = <&msm_gpio 110 0>;
        qcom,msm-ext-pa = "quaternary";
	pinctrl-names = "cdc_lines_act",
			"cdc_lines_sus",
			"cross_conn_det_act",
			"cross_conn_det_sus",
			"cdc_lines_sec_ext_act",
			"cdc_lines_sec_ext_sus",
			"cdc_lines_quat_ext_act",
			"cdc_lines_quat_ext_sus";
	pinctrl-0 = <&cdc_pdm_lines_act>;
	pinctrl-1 = <&cdc_pdm_lines_sus>;
	pinctrl-2 = <&cross_conn_det_act>;
	pinctrl-3 = <&cross_conn_det_sus>;
	pinctrl-4 = <&cdc_pdm_lines_act &cdc_ext_pa_act
			&cdc_ext_pa_d0_act &cdc_ext_mclk_act
			&cross_conn_det_act>;
	pinctrl-5 = <&cdc_pdm_lines_sus &cdc_ext_pa_sus
			&cdc_ext_pa_d0_sus &cdc_ext_mclk_sus
			&cross_conn_det_sus>;
	pinctrl-6 = <&cdc_pdm_lines_act &cdc_ext_tlmm_act
			&cdc_ext_mclk_act &cross_conn_det_act>;
	pinctrl-7 = <&cdc_pdm_lines_sus &cdc_ext_tlmm_sus
			&cdc_ext_mclk_sus &cross_conn_det_sus>;

		         
    };
    
};

