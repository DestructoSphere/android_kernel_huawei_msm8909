## drivers/huawei/Kconfig
```kconfig
menu "huawei linux device driver support package"

source "drivers/huawei/store_exception/Kconfig"

endmenu
```

## drivers/huawei/store_exception/Kconfig
```kconfig
menu HUAWEI_STORE_EXCEPTION

config  HUAWEI_STORE_EXCEPTION
        default n
	bool "huawei store exception"
	help
          huawei store exception control

endmenu
```

## drivers/huawei_platform/Kconfig
```kconfig
config HUAWEI_DRIVERS
	bool "huawei drivers"
	default y
	help
	  Say Y here if you want to build the huawei drivers.
	  If unsure, say N here.

config HUAWEI_SENSORS
	bool "huawei sensors"
	default y
	help
	  Say Y here if you want to build the huawei sensor drivers.If unsure, say N here.

source "drivers/huawei_platform/sensor/Kconfig"

config HUAWEI_TOUCH_SCREEN
	bool "huawei touch screen driver"
	default y
	help
	  Say Y here if you have any touch device connected to your system and want
	  it to be available to applications. 
	  Say N here if you have no touch device in your system.If unsure, say Y.
	  To compile this driver as a module, choose M here: the  module will be called input.

source "drivers/huawei_platform/touchscreen/Kconfig"
```

## drivers/huawei_platform/sensor/Kconfig
```kconfig
config HUAWEI_ACCEL_SENSORS
        bool "huawei accelerometer sensors"
		default y
        help
          Say Y here if you want to build the huawei accelerometer sensor drivers.
		  If unsure, say N here.

source "drivers/huawei_platform/sensor/accelerometer/Kconfig"

config HUAWEI_COMPASS_SENSORS
        bool "huawei accelerometer sensors"
		default y
        help
          Say Y here if you want to build the huawei compass sensor drivers.
		  If unsure, say N here.

source "drivers/huawei_platform/sensor/compass/Kconfig"

config HUAWEI_HALL_SENSORS
        bool "huawei hall sensors"
		default y
        help
          Say Y here if you want to build the huawei hall sensor drivers.
		  If unsure, say N here.

source "drivers/huawei_platform/sensor/hallsensor/Kconfig"
		  
config HUAWEI_LP_SENSORS
        bool "huawei als and proximity sensors"
		default y
        help
          Say Y here if you want to build the huawei als and proximity sensor drivers.
		  If unsure, say N here.

source "drivers/huawei_platform/sensor/lpsensor/Kconfig"

config HUAWEI_SENSOR_INFO
        tristate "Support for sensor self_adapt"
        depends on HUAWEI_KERNEL
        default n
        help
          Say Y to enable support self-adapt

config SENSOR_INFO
        tristate "Support for sensor information"
        depends on HUAWEI_KERNEL
        default n
        help
          Say Y to enable support self-adapt
```

## drivers/huawei_platform/sensor/accelerometer/Kconfig
```kconfig
config HUAWEI_ACCEL_SENSORS_KIONIX
        tristate "ROHM_KX023 3-axis digital acceleromater"
        depends on I2C
	default n
        help
          Say Y here if you want to support ROHM_KX023 accelerometer connected via an I2C bus.
          to compile this driver as a module, choose M here: the module will be called kionix_accel.
 
config HUAWEI_ACCEL_SENSORS_LIS3DH
        tristate "ST LIS3DH 3-axis digital acceleromater"
        depends on I2C
        default n
	help
          Say Y here if you want to support STMicroelectronics LIS3DH accelerometer connected via an I2C bus.
          to compile this driver as a module, choose M here: the module will be called lis3dh_acc.
```

## drivers/huawei_platform/sensor/compass/Kconfig
```kconfig
config HUAWEI_COMPASS_SENSORS_AKM09911
        tristate "AKM09911 3-axis electronic compass sensor driver"
        depends on I2C
        default n
	help
          Say Y here if you want to enable the akm09911 ecompass sensor driver.
          to compile this driver as a module, choose M here: the module will be called akm09911.
```

## drivers/huawei_platform/sensor/hallsensor/Kconfig
```kconfig
config HUAWEI_HALL_SENSORS_AK8789
        tristate "Support for hall sensor AK8789"
        depends on HUAWEI_KERNEL
        default n
        help
          Say Y to enable support ak8789 hall sensor
```

## drivers/huawei_platform/sensor/lpsensor/Kconfig
```kconfig
config HUAWEI_LP_SENSORS_ADUX1050
	tristate "Support for prox sensor adux1050"
	default n
	help
		Say Y to enable support adux1050 prox sensor

config EVAL
	bool "Eval : To enable the driver in evaluation mode for test "
	depends on HUAWEI_LP_SENSORS_ADUX1050
	default n
	help
		To use the generic sysfs path and modifications for the control attributes.

config USE_FILP
	bool "USE_FILP : To make use of the file access from the kernel driver "
	depends on HUAWEI_LP_SENSORS_ADUX1050
	default n
	help
		To enable the file access from the kernel for the purpose of storing and retrieving the calibration results in/from a file and further is enhanced for extraction of configuration during runtime.

config ADUX1050_POLL
	bool "POLL : To make use of the Polling method instead of ISR "
	depends on HUAWEI_LP_SENSORS_ADUX1050
	default n
	help
		To enable the polling and to set the sleep time through the sysfs
				
config HUAWEI_LP_SENSORS_APDS993X
	tristate "Avago APDS993X combined als and proximity sensors"
	depends on I2C
	default n
	help
	  Say Y here if you want to build a driver for Avago APDS993X
	  combined ambient light and proximity sensor chip.
	  To compile this driver as a module, choose M here: the module will be called apds993x. If unsure, say N here.
		  
config HUAWEI_LP_SENSORS_PA224
    tristate "pa224 als and proximity sensors"
    depends on I2C
	default n
	help
	  Say Y here if you want to build a driver for pa224 combined ambient light and proximity sensor chip.
	  To compile this driver as a module, choose M here: the module will be called pa224. If unsure, say N here.

config HUAWEI_LP_SENSORS_ROHM_RPR521
	tristate "ROHM RPR0521 combined als and proximity sensors"
	depends on I2C
	default n
	help
	  Say Y here if you want to build a driver for ROHM RPR0521 combined ambient light and proximity sensor chip.
	  To compile this driver as a module, choose M here: the module will be called rpr0521. If unsure, say N here.

config HUAWEI_LP_SENSORS_ROHM_RGB_BH1745
	tristate "ROHM RGB_BH1745 als sensors"
	depends on I2C
	default n
	help
	  Say Y here if you want to build a driver for RGB_BH1745 ambient light sensor chip.
	  To compile this driver as a module, choose M here: the module will be called bh1745. If unsure, say N here.
		  
config HUAWEI_LP_SENSORS_AP3426
	tristate "AP3426 3-in-1 digital ALPS+PS+IRLED sensor driver"
	depends on I2C
	default n
	help
	  Say Y here if you want to enable the AP3426 ALPS sensor driver.
	  To compile this driver as a module, choose M here: the module will be called ap3426.
```

## drivers/huawei_platform/touchscreen/Kconfig
```kconfig
config CYTTSP5_CS445A
	tristate "cypress cs445a touch screen driver"
	default n
	help
	  Say Y here if you have cypress touch device us cyttsp5 to connected to your system and want
	  it to be available to applications. 
	  Say N here if you have no cypress touch device use cyttsp5 in your system.
	  If unsure, say Y.
	  To compile this driver as a module, choose M here: the
	  module will be called input.
source "drivers/huawei_platform/touchscreen/cyttsp5_cs445a/Kconfig"

config SYNAPTICS_DSX
	tristate "synaptics touch screen driver"
	default n
	help
	  Say Y here if you have synaptics s3207 device connected to your system and want
	  it to be available to applications. 
	  Say N here if you have no synaptics s3207 device in your system.
	  If unsure, say Y.
	  To compile this driver as a module, choose M here: the
	  module will be called input.
source "drivers/huawei_platform/touchscreen/synaptics_dsx/Kconfig"

config GT_9XX
	tristate "goodix touch screen driver"
	default n
	help
	  Say Y here if you have goodix touch device connected to your system and want
	  it to be available to applications. 
	  Say N here if you have no goodix touch device in your system.	  
	  If unsure, say Y.
	  To compile this driver as a module, choose M here: the
	  module will be called input.
source "drivers/huawei_platform/touchscreen/gt9xx/Kconfig"

config MSTAR_2142
	tristate "mstar 2142 touch screen driver"
	default n
	help
	  Say Y here if you have mstar 2142 touch device connected to your system and want
	  it to be available to applications. 
	  Say N here if you have no mstar 2142 touch device in your system.
	  If unsure, say Y.
	  To compile this driver as a module, choose M here: the
	  module will be called input.
source "drivers/huawei_platform/touchscreen/mstar_2142/Kconfig"

config FOCALTECH_6X36
	tristate "focaltech 6x06 touch screen driver"
	default n
	help
	  Say Y here if you have focaltech 6x06 touch device connected to your system and want
	  it to be available to applications. 
	  Say N here if you have no focaltech 6x06 touch device in your system.
	  If unsure, say Y.
	  To compile this driver as a module, choose M here: the
	  module will be called input.
source "drivers/huawei_platform/touchscreen/focaltech_6x36/Kconfig"

config NOVATEK_205
    tristate "novatek 205 touch screen driver"
    default n
    help
      Say Y here if you have novatek 205 touch device connected to your system and want
      it to be available to applications. 
      Say N here if you have no novatek 205 touch device in your system.
      If unsure, say Y.
      To compile this driver as a module, choose M here: the
      module will be called input.
source "drivers/huawei_platform/touchscreen/novatek_205/Kconfig"
```

## drivers/huawei_platform/touchscreen/focaltech_6x36/Kconfig
```kconfig
config FOCALTECH_F6X06_TP_ENABLE
	bool "Enable Focaltech for Ft6x06-Tp Driver"
	depends on TOUCHSCREEN_HUAWEI_FOCALTECH_FT6X06
	default n
	help
      	  enable the f6x06_tp of focaltech

config FOCALTECH_FT6X06_TS 
	tristate "Focaltech_ft6x06_ts"
	depends on FOCALTECH_F6X06_TP_ENABLE
	default n
	help
	  the first file for ft6x06 touchpanel driver  

config FOCALTECH_FOCALTECH_USERDATA
	tristate "Focaltech Ctl Touchscreen"
	depends on FOCALTECH_FT6X06_TS
	default n
	help
	  userdata interface

config FOCALTECH_FT6X06_UPDATA_FW
	tristate "Focaltech_ft6x06_ex_fun"
	depends on FOCALTECH_FT6X06_TS
	default n
	help
	  updata interface

config FOCALTECH_FT6X06_SYSDEBUG 
	tristate "Focaltech_ft6x06_sysdbug"
	depends on FOCALTECH_FT6X06_TS && FOCALTECH_FT6X06_UPDATA_FW
	default n
	help
	  the first file for ft6x06 sysdebug  

#delete define of FOCALTECH_FT6X06_SCAP_TEST
```

## drivers/huawei_platform/touchscreen/gt9xx/Kconfig
```kconfig
#
# Goodix GT9xx Touchscreen driver
#

config GT9XX_TOUCHPANEL_DRIVER
	tristate "Goodix GT9xx touchpanel driver"
	depends on I2C
	default n

	help
	  Say Y here if you have a Goodix GT9xx touchscreen connected
	  to your system.

	  If unsure, say N.

	  To compile this driver as a module, choose M here: the
	  module will be called gt9xx.

config GT9XX_TOUCHPANEL_UPDATE
	tristate "Goodix GT9xx touchpanel auto update support"
	depends on GT9XX_TOUCHPANEL_DRIVER
	default n
	help
	  This enables support for firmware update for Goodix GT9xx
	  touchscreens.


config GT9XX_TOUCHPANEL_DEBUG
	tristate "Goodix GT9xx Tools for debuging"
	depends on GT9XX_TOUCHPANEL_DRIVER
	default n
	help
	  This is application debug interface support for Goodix GT9xx
	  touchscreens.
config GT9XX_TOUCHPANEL_OPENSHORT_TEST
	tristate "Goodix GT9xx Tools for open and short test"
	depends on GT9XX_TOUCHPANEL_DRIVER
	default n
	help
	  This is open and short test support for Goodix GT9xx
	  touchscreens.
```

## drivers/huawei_platform/touchscreen/mstar_2142/Kconfig
```kconfig
#MSG2138_GC
config MSG2138_GC
	tristate "MSG2138_GC Touchscreen Driver"
	depends on HUAWEI_KERNEL
	default y
	help
	  Core driver for MSG2138_GC Standard Product
	  Say Y here if you have a MSG2138_GC touchscreen.
	  If unsure, say N.
	  To compile this driver as a module, choose M here.

#MSG2138_SCAP_TEST
config MSG2138_SCAP_TEST
	tristate "MSG2138_SCAP_TEST Touchscreen detect"
	#depends on HUAWEI_KERNEL
	default n
	help
	  Core driver for MSG2138_SCAP_TEST Standard Product
	  Say Y here if you have a MSG2138_SCAP_TEST touchscreen.
	  If unsure, say N.
	  To compile this driver as a module, choose M here.
```

## drivers/huawei_platform/touchscreen/synaptics_dsx/Kconfig
```kconfig
#
# Synaptics DSX touchscreen driver configuration
#

#/*Add synaptics new driver "Synaptics DSX I2C V2.0"*/
config TOUCHSCREEN_HUAWEI_DSX_I2C
	tristate "Synaptics DSX I2C touchscreen"
	depends on I2C
	default n
	help
	  Say Y here if you have a Synaptics DSX I2C touchscreen
	  connected to your system.

	  If unsure, say N.

	  To compile this driver as a module, choose M here: the
	  module will be called synaptics_dsx_i2c.

config TOUCHSCREEN_HUAWEI_DSX_RMI_DEV
	tristate "Synaptics DSX touchscreen char device"
	depends on I2C
	default n
	help
	  This enables support for direct register access for Synaptics DSX
	  touchscreens.

config TOUCHSCREEN_HUAWEI_DSX_FW_UPDATE
	tristate "Synaptics DSX touchscreen firmware update"
	depends on I2C
	default n
	help
	  This enables support for firmware update for Synaptics DSX
	  touchscreens.

config TOUCHSCREEN_HUAWEI_DSX_TEST_REPORTING
	tristate "Synaptics DSX touchscreen test reporting"
	depends on I2C
	default n
	help
	  This enables support for test reporting for Synaptics DSX
	  touchscreens.

config TOUCHSCREEN_HUAWEI_DSX_PROXIMITY
	tristate "Synaptics DSX touchscreen proximity"
	depends on I2C
	default n
	help
	  This enables support for proximity for Synaptics DSX
	  touchscreens.

config TOUCHSCREEN_HUAWEI_DSX_ESD
	tristate "Synaptics DSX touchscreen esd"
	depends on I2C
	default n
	help
	  This enables support for proximity for Synaptics DSX
	  touchscreens.
```

## drivers/hw_fac_info/Kconfig
```kconfig
#
# FOR HUAWEI FACTORY INFO
#

config HUAWEI_FACTORY_INFO
	default y
	depends on  HUAWEI_KERNEL
	bool "HUAWEI Factory INFO"
	help
		Say yes if you want enable factory info driver.
		This is for distinguish the different product . If unsure, say Y here.
```

## drivers/misc/huawei_reset_detect/Kconfig
```kconfig
config HUAWEI_RESET_DETECT
	tristate "detect abnormal reset"
	depends on HUAWEI_KERNEL
	default n
	help
	  Say Y here to detect abnormal reset
```

## drivers/mmc/Kconfig
```kconfig
#
# MMC subsystem configuration
#

menuconfig MMC
	tristate "MMC/SD/SDIO card support"
	depends on HAS_IOMEM
	help
	  This selects MultiMediaCard, Secure Digital and Secure
	  Digital I/O support.

	  If you want MMC/SD/SDIO support, you should say Y here and
	  also to your specific host controller driver.

config MMC_DEBUG
	bool "MMC debugging"
	depends on MMC != n
	help
	  This is an option for use by developers; most people should
	  say N here.  This enables MMC core and driver debugging.

config MMC_PERF_PROFILING
	bool "MMC performance profiling"
	depends on MMC != n
	default n
	help
	  If you say Y here, support will be added for collecting
	  performance numbers at the MMC Queue and Host layers.

config HUAWEI_MMC
        tristate "Secure Digital Host Controller Interface support"
        depends on HUAWEI_KERNEL
        default n
        help
          use huawei feature

config HUAWEI_SDCARD_DSM
	bool "Listen sdcard kernel err"
	depends on HUAWEI_DSM != n
	default n
	help
	  use huawei sdcard log radar

config HUAWEI_EMMC_DSM
	bool "Listen eMMC kernel err"
	depends on HUAWEI_DSM != n
	default n
	help
	  use huawei eMMC log radar

config HUAWEI_EMMC_DSM_DEBUG
	bool "Listen eMMC radar err on debug stage"
	depends on HUAWEI_DSM != n
	default n
	help
	  use device radar only to record emmc vdet log

config MMC_SWRM
       tristate "Sandisk Write Read Module"
       depends on MMC != n
       help
         This option is used for updating Sandisk iNAND firmware.

if MMC

source "drivers/mmc/core/Kconfig"

source "drivers/mmc/card/Kconfig"

source "drivers/mmc/host/Kconfig"

endif # MMC
```
